## Level-2(not-finishedTAT)/MP3-flash-storage/sdkconfig.defaults
```kconfig
# ESP32-S3 MP3 Player Default Configuration

# Target
CONFIG_IDF_TARGET="esp32s3"

# Flash size (8MB for N8R8)
CONFIG_ESPTOOLPY_FLASHSIZE_8MB=y
CONFIG_ESPTOOLPY_FLASHSIZE="8MB"

# Partition Table
CONFIG_PARTITION_TABLE_CUSTOM=y
CONFIG_PARTITION_TABLE_CUSTOM_FILENAME="partitions.csv"
CONFIG_PARTITION_TABLE_FILENAME="partitions.csv"
CONFIG_PARTITION_TABLE_OFFSET=0x8000

# SPIFFS Configuration
CONFIG_SPIFFS_PAGE_SIZE=256
CONFIG_SPIFFS_OBJ_NAME_LEN=64
CONFIG_SPIFFS_USE_MAGIC=y
CONFIG_SPIFFS_USE_MAGIC_LENGTH=y
CONFIG_SPIFFS_META_LENGTH=4
CONFIG_SPIFFS_USE_MTIME=y

# I2S Configuration
CONFIG_I2S_ENABLE_DEBUG_LOG=n

# FreeRTOS
CONFIG_FREERTOS_HZ=1000

# Main task
CONFIG_MAIN_TASK_STACK_SIZE=8192

# Log level
CONFIG_LOG_DEFAULT_LEVEL_INFO=y

# ESP32-S3 specific
# PSRAM disabled for compatibility
CONFIG_ESP32S3_SPIRAM_SUPPORT=n
CONFIG_ESP32S3_DEFAULT_CPU_FREQ_240=y

# New I2S driver
CONFIG_I2S_STD_EN=y
CONFIG_I2S_SUPPORTS_ADC=n
CONFIG_I2S_SUPPORTS_ADC_DAC=n
```

## Level-2(not-finishedTAT)/MP3/main/Kconfig.projbuild
```kconfig
menu "MP3 Player Configuration"

    config MP3_SD_MOSI_GPIO
        int "SD Card MOSI GPIO"
        default 4
        help
            GPIO number for SD card MOSI (SD_CMD/SDI/SD_DI).
            Use GPIO4 (tested working).

    config MP3_SD_MISO_GPIO
        int "SD Card MISO GPIO"
        default 5
        help
            GPIO number for SD card MISO (SD_DO/SDO).
            Use GPIO5 (tested working).

    config MP3_SD_SCK_GPIO
        int "SD Card SCK GPIO"
        default 2
        help
            GPIO number for SD card SCK (SCLK/CLK).
            Use GPIO2 (tested working).

    config MP3_SD_CS_GPIO
        int "SD Card CS GPIO"
        default 8
        help
            GPIO number for SD card CS (SS).
            Use GPIO8 (tested working).

    config MP3_I2S_BCLK_GPIO
        int "I2S BCLK GPIO"
        default 10
        help
            GPIO number for I2S bit clock (BCLK).
            Changed from GPIO4 to avoid conflict with SD card MOSI.

    config MP3_I2S_LRCK_GPIO
        int "I2S LRCK GPIO"
        default 11
        help
            GPIO number for I2S left-right clock (LRCK/WS).
            Changed from GPIO5 to avoid conflict with SD card MISO.

    config MP3_I2S_DATA_GPIO
        int "I2S DATA GPIO"
        default 6
        help
            GPIO number for I2S data output (DOUT/DIN).

    config MP3_I2S_SD_MODE_GPIO
        int "I2S SD_MODE GPIO (MAX98357A SHUTDOWN)"
        default 7
        help
            GPIO number for MAX98357A SD_MODE (shutdown control, active high).

    choice MP3_SPI_HOST
        prompt "SPI Host for SD Card"
        default MP3_SPI_HOST_SPI2
        help
            Select SPI host for SD card communication.
            SPI2 (HSPI) tested working with GPIO2/4/5/8.

        config MP3_SPI_HOST_SPI1
            bool "SPI1"
        config MP3_SPI_HOST_SPI2
            bool "SPI2 (HSPI)"
        config MP3_SPI_HOST_SPI3
            bool "SPI3 (VSPI)"
    endchoice

    config MP3_SPI_DMA_CHAN
        int "SPI DMA Channel"
        default 1
        range 1 2
        help
            DMA channel for SPI.

    config MP3_SAMPLE_RATE
        int "Audio Sample Rate"
        default 44100
        range 8000 48000
        help
            Audio sample rate in Hz.

    config MP3_BUFFER_SIZE
        int "Audio Buffer Size"
        default 4096
        range 1024 16384
        help
            Size of audio buffer in bytes.

    comment "UART Configuration for File Transfer"

    config MP3_UART_PORT
        int "UART Port for File Transfer"
        default 0
        range 0 2
        help
            UART port number for file transfer.
            UART0 is the default console port.

    config MP3_UART_BAUD
        int "UART Baud Rate for File Transfer"
        default 115200
        range 9600 2000000
        help
            Baud rate for file transfer UART.
            115200 is reliable. Higher speeds may need flow control.

    config MP3_ENABLE_FILE_TRANSFER_TASK
        bool "Enable File Transfer Background Task"
        default n
        help
            Enable background task for file transfer.
            NOTE: This conflicts with console input. Use 'transfer' command instead.

endmenu
```

## Level-2(not-finishedTAT)/MP3/sdkconfig.defaults
```kconfig
# ESP32-S3 MP3 Player Default Configuration

# Board selection
CONFIG_IDF_TARGET="esp32s3"

# Partition table
CONFIG_PARTITION_TABLE_CUSTOM=y
CONFIG_PARTITION_TABLE_CUSTOM_FILENAME="partitions.csv"
CONFIG_PARTITION_TABLE_FILENAME="partitions.csv"

# Flash size
CONFIG_ESPTOOLPY_FLASHSIZE_8MB=y
CONFIG_ESPTOOLPY_FLASHSIZE="8MB"

# SPIRAM (optional but recommended)
CONFIG_SPIRAM=y
CONFIG_SPIRAM_MODE_OCT=y

# Enable FATFS long filename support
CONFIG_FATFS_LFN_HEAP=y
CONFIG_FATFS_MAX_LFN=255

# Enable console
CONFIG_ESP_CONSOLE_UART_DEFAULT=y
CONFIG_ESP_CONSOLE_UART_BAUDRATE=115200

# Log level
CONFIG_LOG_DEFAULT_LEVEL_INFO=y
CONFIG_LOG_DEFAULT_LEVEL=3

# FreeRTOS
CONFIG_FREERTOS_HZ=1000

# Enable NVS
CONFIG_NVS_ENCRYPTION=n
```
